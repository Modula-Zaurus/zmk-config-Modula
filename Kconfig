## Kconfig
```kconfig
DT_COMPAT_MODULA_BEHAVIOR_ALT_GUI_MORPH := modula,behavior-alt-gui-morph

config MODULA_BEHAVIOR_ALT_GUI_MORPH
    bool "Modula Alt/GUI key morph behavior"
    depends on !ZMK_SPLIT || ZMK_SPLIT_ROLE_CENTRAL
    default $(dt_compat_enabled,$(DT_COMPAT_MODULA_BEHAVIOR_ALT_GUI_MORPH))
```

## boards/shields/Modula/Kconfig.defconfig
```kconfig
if SHIELD_MODULA_R
    config ZMK_SPLIT_ROLE_CENTRAL
        default y
    config BT_MAX_CONN
        default 8
    config BT_MAX_PAIRED
        default 8
endif

if SHIELD_MODULA_R||SHIELD_MODULA_L
    config ZMK_KEYBOARD_NAME
        default "Modula"

    config ZMK_SPLIT
        default y
    
endif 

if ZMK_BACKLIGHT

config PWM
    default y

config LED_PWM
    default y

endif # ZMK_BACKLIGHT
```

## boards/shields/Modula/Kconfig.shield
```kconfig
config SHIELD_MODULA_R
    def_bool $(shields_list_contains,Modula_R)
    
config SHIELD_MODULA_L
    def_bool $(shields_list_contains,Modula_L)
```

## config/west.yml
```yaml
manifest:
  remotes:
    - name: zmkfirmware
      url-base: https://github.com/zmkfirmware
    - name: caksoylar
      url-base: https://github.com/caksoylar
    - name: badjeff
      url-base: https://github.com/badjeff
    - name: sekigon-gonnoc
      url-base: https://github.com/sekigon-gonnoc
    - name: BP
      url-base: https://github.com/taichan1113
    # - name: MaXMaNDeV
    #   url-base: https://github.com/MaXMaNDeV

  projects:
    - name: zmk
      remote: zmkfirmware
      revision: v0.3
      # revision: main
      import: app/west.yml

    - name: zmk-rgbled-widget  # https://github.com/caksoylar/zmk-rgbled-widget
      remote: caksoylar
      revision: v0.3-branch
      # revision: main

    - name: zmk-pmw3610-driver # https://github.com/badjeff/zmk-pmw3610-driver
      remote: badjeff
      revision: zmk-v0.3
      revision: main

    - name: zmk-driver-paw3222
      remote: sekigon-gonnoc
      revision: main
      # revision: torabo-tsuki

    - name: zmk-driver-pat9125 # https://github.com/taichan1113/zmk-driver-pat9125
      remote: BP
      revision: main

    # - name: zmk-behavior-insomnia
    #   remote: badjeff
    #   revision: main

    - name: zmk-behavior-quick-scroll
      remote: BP
      revision: main

    - name: zmk-typing-pwm
      remote: BP
      revision: main

    - name: zmk-behavior-jp
      remote: BP
      revision: main

    # - name: zmk-layout-shift
    #   remote: kot149
    #   revision: v1

  self:
    path: config
    
```

## dts/bindings/behaviors/modula,behavior-alt-gui-morph.yaml
```yaml
description: Select a binding for normal, Alt, or GUI input

compatible: "modula,behavior-alt-gui-morph"

include: zero_param.yaml

properties:
  bindings:
    type: phandle-array
    required: true
```
