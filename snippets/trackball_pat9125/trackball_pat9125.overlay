#include <zephyr/dt-bindings/input/input-event-codes.h>
#include <input/processors.dtsi>
#include "../pinctrl_i2c.dtsi"
#include "../listners.dtsi"


// &gpio1 {
//     sensor_wakeup {
//         gpio-hog;
//         gpios = <12 GPIO_ACTIVE_LOW>;
//         output-low;
//     };
// };

&i2c1 {
	status = "okay";
	compatible = "nordic,nrf-twim";
	pinctrl-0 = <&i2c1_default>;
	pinctrl-1 = <&i2c1_sleep>;
	pinctrl-names = "default", "sleep";
	// clock-frequency = <I2C_BITRATE_FAST>;
    // #address-cells = <1>;
    // #size-cells = <0>;

	trackball_pat9125: trackball_pat9125@79 {
		status = "okay";
		compatible = "pixart,pat9125";
		reg = <0x79>; // HIGH:0x73, LOW:0x75, NC:0x79
		motion-gpios = <&gpio1 0 (GPIO_ACTIVE_LOW | GPIO_PULL_UP)>;
		res-x-cpi = <300>;
		res-y-cpi = <300>;
		zephyr,axis-x = <INPUT_REL_X>;
		zephyr,axis-y = <INPUT_REL_Y>;
		// invert-x;
		// invert-y;
		sleep1-enable;
		sleep2-enable;
	};
};

&split_peripheral {
	status = "okay";
	device = <&trackball_pat9125>;
};

// &pointer {
//     status = "okay";
//     device = <&trackball>;
// };

// &cpi_cyc{
//     status = "okay";
//     sensor_device = <&trackball>;
// };
